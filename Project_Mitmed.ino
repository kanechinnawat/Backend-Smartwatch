#include <ESPAsyncWebServer.h>
#include <AsyncTCP.h>
#include <HTTPClient.h>
#include <WiFi.h>
#include "wificonfigwebpage.h"
#include <PubSubClient.h>
#include "FS.h"
#include <LittleFS.h>
#include <ArduinoJson.h>
#include "time.h"
#include <U8g2lib.h>
#include <MPU9250_WE.h>
#include <JC_Button.h>
// #include "MAX30105.h"
// #include "heartRate.h"
#include <Wire.h>
#include "MAX30100_PulseOximeter.h"



//time config
const char* ntpServer = "pool.ntp.org";
const long gmtOffset_sec = 7 * 3600;
const int daylightOffset_sec = 0;

time_t initialEpoch;  
unsigned long initialMillis;
bool isTimeSynced = false;

//oled and btn config
U8G2_SH1106_128X64_NONAME_F_HW_I2C u8g2(U8G2_R0, /* reset=*/U8X8_PIN_NONE);

Button myBtn1(5);
Button myBtn2(6);
const unsigned long LONG_PRESS = 5000;
int current_screen = 0;
bool trigger = false;
bool btnstate = false;

bool actionTriggered = false;

uint32_t tsLastScreenUpdate = 0;
#define SCREEN_UPDATE_PERIOD_MS 2500

const unsigned char epd_bitmap_background[] PROGMEM = {
  0x00, 0x00, 0x00, 0x00, 0x00, 0x00, 0x00, 0x00, 0x00, 0x00, 0x00, 0x00, 0x00, 0x00, 0x00, 0x00,
  0x01, 0xff, 0xff, 0xff, 0xff, 0xff, 0xff, 0xff, 0xff, 0xff, 0xff, 0xff, 0xff, 0xff, 0xff, 0xc0,
  0x03, 0x00, 0x00, 0x00, 0x00, 0x00, 0x00, 0x00, 0x00, 0x00, 0x01, 0x00, 0x00, 0x00, 0x01, 0xe0,
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  0x00, 0x00, 0x00, 0x00, 0x00, 0x00, 0x00, 0x00, 0x00, 0x00, 0x00, 0x00, 0x00, 0x00, 0x00, 0x00
};

const unsigned char epd_bitmap_alert_background[] PROGMEM = {
  0x00, 0x00, 0x00, 0x00, 0x00, 0x00, 0x00, 0x00, 0x00, 0x00, 0x00, 0x00, 0x00, 0x00, 0x00, 0x00,
  0x01, 0xff, 0xff, 0xff, 0xff, 0xff, 0xff, 0xff, 0xff, 0xff, 0xff, 0xff, 0xff, 0xff, 0xff, 0xc0,
  0x03, 0x00, 0x00, 0x00, 0x00, 0x00, 0x00, 0x00, 0x00, 0x00, 0x00, 0x00, 0x00, 0x00, 0x01, 0xe0,
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  0x00, 0x00, 0x00, 0x00, 0x00, 0x00, 0x00, 0x00, 0x00, 0x00, 0x00, 0x00, 0x00, 0x00, 0x00, 0x00
};

const unsigned char epd_bitmap_icon_heart[] PROGMEM = {
  0x1c, 0x38, 0x26, 0x6c, 0x43, 0x86, 0x41, 0x02, 0x80, 0x03, 0x80, 0x01, 0x80, 0x01, 0x80, 0x03,
  0xc0, 0x07, 0x60, 0x0e, 0x30, 0x1c, 0x18, 0x38, 0x0c, 0x70, 0x06, 0xe0, 0x03, 0xc0, 0x01, 0x80
};

// const unsigned char epd_bitmap_alert_background[] PROGMEM = {
// 	0xff, 0xff, 0xff, 0xff, 0xff, 0xff, 0xff, 0xff, 0xff, 0xff, 0xff, 0xff, 0xff, 0xff, 0xff, 0xff,
// 	0xff, 0xff, 0xff, 0xff, 0xff, 0xff, 0xff, 0xff, 0xff, 0xff, 0xff, 0xff, 0xff, 0xff, 0xff, 0xff,
// 	0xff, 0xff, 0xff, 0xff, 0xff, 0xff, 0xff, 0xff, 0xff, 0xff, 0xff, 0xff, 0xff, 0xff, 0xff, 0xff,
// 	0xff, 0xff, 0xff, 0xff, 0xff, 0xff, 0xff, 0xff, 0xff, 0xff, 0xff, 0xff, 0xff, 0xff, 0xff, 0xff,
// 	0xff, 0xff, 0xff, 0xff, 0xff, 0xff, 0xff, 0xff, 0xff, 0xff, 0xff, 0xff, 0xff, 0xff, 0xff, 0xff,
// 	0xfc, 0x00, 0x00, 0x00, 0x00, 0x00, 0x00, 0x00, 0x00, 0x00, 0x00, 0x00, 0x00, 0x00, 0x00, 0x3f,
// 	0xf8, 0x00, 0x00, 0x00, 0x00, 0x00, 0x00, 0x00, 0x00, 0x00, 0x00, 0x00, 0x00, 0x00, 0x00, 0x1f,
// 	0xf8, 0x00, 0x00, 0x00, 0x00, 0x00, 0x00, 0x00, 0x00, 0x00, 0x00, 0x00, 0x00, 0x00, 0x00, 0x1f,
// 	0xf8, 0x00, 0x00, 0x00, 0x00, 0x00, 0x00, 0x00, 0x00, 0x00, 0x00, 0x00, 0x00, 0x00, 0x00, 0x1f,
// 	0xf8, 0x00, 0x00, 0x00, 0x00, 0x00, 0x00, 0x00, 0x00, 0x00, 0x00, 0x00, 0x00, 0x00, 0x00, 0x1f,
// 	0xf8, 0x00, 0x00, 0x00, 0x00, 0x00, 0x00, 0x00, 0x00, 0x00, 0x00, 0x00, 0x00, 0x00, 0x00, 0x1f,
// 	0xf8, 0x00, 0x00, 0x00, 0x00, 0x00, 0x00, 0x00, 0x00, 0x00, 0x00, 0x00, 0x00, 0x00, 0x00, 0x1f,
// 	0xf8, 0x00, 0x00, 0x00, 0x00, 0x00, 0x00, 0x00, 0x00, 0x00, 0x00, 0x00, 0x00, 0x00, 0x00, 0x1f,
// 	0xf8, 0x00, 0x00, 0x00, 0x00, 0x00, 0x00, 0x00, 0x00, 0x00, 0x00, 0x00, 0x00, 0x00, 0x00, 0x1f,
// 	0xf8, 0x00, 0x00, 0x00, 0x00, 0x00, 0x00, 0x00, 0x00, 0x00, 0x00, 0x00, 0x00, 0x00, 0x00, 0x1f,
// 	0xf8, 0x00, 0x00, 0x00, 0x00, 0x00, 0x00, 0x00, 0x00, 0x00, 0x00, 0x00, 0x00, 0x00, 0x00, 0x1f,
// 	0xf8, 0x00, 0x00, 0x00, 0x00, 0x00, 0x00, 0x00, 0x00, 0x00, 0x00, 0x00, 0x00, 0x00, 0x00, 0x1f,
// 	0xf8, 0x00, 0x00, 0x00, 0x00, 0x00, 0x00, 0x00, 0x00, 0x00, 0x00, 0x00, 0x00, 0x00, 0x00, 0x1f,
// 	0xf8, 0x00, 0x00, 0x00, 0x00, 0x00, 0x00, 0x00, 0x00, 0x00, 0x00, 0x00, 0x00, 0x00, 0x00, 0x1f,
// 	0xf8, 0x00, 0x00, 0x00, 0x00, 0x00, 0x00, 0x00, 0x00, 0x00, 0x00, 0x00, 0x00, 0x00, 0x00, 0x1f,
// 	0xf8, 0x00, 0x00, 0x00, 0x00, 0x00, 0x00, 0x00, 0x00, 0x00, 0x00, 0x00, 0x00, 0x00, 0x00, 0x1f,
// 	0xf8, 0x00, 0x00, 0x00, 0x00, 0x00, 0x00, 0x00, 0x00, 0x00, 0x00, 0x00, 0x00, 0x00, 0x00, 0x1f,
// 	0xf8, 0x00, 0x00, 0x00, 0x00, 0x00, 0x00, 0x00, 0x00, 0x00, 0x00, 0x00, 0x00, 0x00, 0x00, 0x1f,
// 	0xf8, 0x00, 0x00, 0x00, 0x00, 0x00, 0x00, 0x00, 0x00, 0x00, 0x00, 0x00, 0x00, 0x00, 0x00, 0x1f,
// 	0xf8, 0x00, 0x00, 0x00, 0x00, 0x00, 0x00, 0x00, 0x00, 0x00, 0x00, 0x00, 0x00, 0x00, 0x00, 0x1f,
// 	0xf8, 0x00, 0x00, 0x00, 0x00, 0x00, 0x00, 0x00, 0x00, 0x00, 0x00, 0x00, 0x00, 0x00, 0x00, 0x1f,
// 	0xf8, 0x00, 0x00, 0x00, 0x00, 0x00, 0x00, 0x00, 0x00, 0x00, 0x00, 0x00, 0x00, 0x00, 0x00, 0x1f,
// 	0xf8, 0x00, 0x00, 0x00, 0x00, 0x00, 0x00, 0x00, 0x00, 0x00, 0x00, 0x00, 0x00, 0x00, 0x00, 0x1f,
// 	0xf8, 0x00, 0x00, 0x00, 0x00, 0x00, 0x00, 0x00, 0x00, 0x00, 0x00, 0x00, 0x00, 0x00, 0x00, 0x1f,
// 	0xf8, 0x00, 0x00, 0x00, 0x00, 0x00, 0x00, 0x00, 0x00, 0x00, 0x00, 0x00, 0x00, 0x00, 0x00, 0x1f,
// 	0xf8, 0x00, 0x00, 0x00, 0x00, 0x00, 0x00, 0x00, 0x00, 0x00, 0x00, 0x00, 0x00, 0x00, 0x00, 0x1f,
// 	0xf8, 0x00, 0x00, 0x00, 0x00, 0x00, 0x00, 0x00, 0x00, 0x00, 0x00, 0x00, 0x00, 0x00, 0x00, 0x1f,
// 	0xf8, 0x00, 0x00, 0x00, 0x00, 0x00, 0x00, 0x00, 0x00, 0x00, 0x00, 0x00, 0x00, 0x00, 0x00, 0x1f,
// 	0xf8, 0x00, 0x00, 0x00, 0x00, 0x00, 0x00, 0x00, 0x00, 0x00, 0x00, 0x00, 0x00, 0x00, 0x00, 0x1f,
// 	0xf8, 0x00, 0x00, 0x00, 0x00, 0x00, 0x00, 0x00, 0x00, 0x00, 0x00, 0x00, 0x00, 0x00, 0x00, 0x1f,
// 	0xf8, 0x00, 0x00, 0x00, 0x00, 0x00, 0x00, 0x00, 0x00, 0x00, 0x00, 0x00, 0x00, 0x00, 0x00, 0x1f,
// 	0xf8, 0x00, 0x00, 0x00, 0x00, 0x00, 0x00, 0x00, 0x00, 0x00, 0x00, 0x00, 0x00, 0x00, 0x00, 0x1f,
// 	0xf8, 0x00, 0x00, 0x00, 0x00, 0x00, 0x00, 0x00, 0x00, 0x00, 0x00, 0x00, 0x00, 0x00, 0x00, 0x1f,
// 	0xf8, 0x00, 0x00, 0x00, 0x00, 0x00, 0x00, 0x00, 0x00, 0x00, 0x00, 0x00, 0x00, 0x00, 0x00, 0x1f,
// 	0xf8, 0x00, 0x00, 0x00, 0x00, 0x00, 0x00, 0x00, 0x00, 0x00, 0x00, 0x00, 0x00, 0x00, 0x00, 0x1f,
// 	0xf8, 0x00, 0x00, 0x00, 0x00, 0x00, 0x00, 0x00, 0x00, 0x00, 0x00, 0x00, 0x00, 0x00, 0x00, 0x1f,
// 	0xf8, 0x00, 0x00, 0x00, 0x00, 0x00, 0x00, 0x00, 0x00, 0x00, 0x00, 0x00, 0x00, 0x00, 0x00, 0x1f,
// 	0xf8, 0x00, 0x00, 0x00, 0x00, 0x00, 0x00, 0x00, 0x00, 0x00, 0x00, 0x00, 0x00, 0x00, 0x00, 0x1f,
// 	0xf8, 0x00, 0x00, 0x00, 0x00, 0x00, 0x00, 0x00, 0x00, 0x00, 0x00, 0x00, 0x00, 0x00, 0x00, 0x1f,
// 	0xf8, 0x00, 0x00, 0x00, 0x00, 0x00, 0x00, 0x00, 0x00, 0x00, 0x00, 0x00, 0x00, 0x00, 0x00, 0x1f,
// 	0xf8, 0x00, 0x00, 0x00, 0x00, 0x00, 0x00, 0x00, 0x00, 0x00, 0x00, 0x00, 0x00, 0x00, 0x00, 0x1f,
// 	0xf8, 0x00, 0x00, 0x00, 0x00, 0x00, 0x00, 0x00, 0x00, 0x00, 0x00, 0x00, 0x00, 0x00, 0x00, 0x1f,
// 	0xf8, 0x00, 0x00, 0x00, 0x00, 0x00, 0x00, 0x00, 0x00, 0x00, 0x00, 0x00, 0x00, 0x00, 0x00, 0x1f,
// 	0xf8, 0x00, 0x00, 0x00, 0x00, 0x00, 0x00, 0x00, 0x00, 0x00, 0x00, 0x00, 0x00, 0x00, 0x00, 0x1f,
// 	0xf8, 0x00, 0x00, 0x00, 0x00, 0x00, 0x00, 0x00, 0x00, 0x00, 0x00, 0x00, 0x00, 0x00, 0x00, 0x1f,
// 	0xf8, 0x00, 0x00, 0x00, 0x00, 0x00, 0x00, 0x00, 0x00, 0x00, 0x00, 0x00, 0x00, 0x00, 0x00, 0x1f,
// 	0xf8, 0x00, 0x00, 0x00, 0x00, 0x00, 0x00, 0x00, 0x00, 0x00, 0x00, 0x00, 0x00, 0x00, 0x00, 0x1f,
// 	0xf8, 0x00, 0x00, 0x00, 0x00, 0x00, 0x00, 0x00, 0x00, 0x00, 0x00, 0x00, 0x00, 0x00, 0x00, 0x1f,
// 	0xf8, 0x00, 0x00, 0x00, 0x00, 0x00, 0x00, 0x00, 0x00, 0x00, 0x00, 0x00, 0x00, 0x00, 0x00, 0x1f,
// 	0xf8, 0x00, 0x00, 0x00, 0x00, 0x00, 0x00, 0x00, 0x00, 0x00, 0x00, 0x00, 0x00, 0x00, 0x00, 0x1f,
// 	0xf8, 0x00, 0x00, 0x00, 0x00, 0x00, 0x00, 0x00, 0x00, 0x00, 0x00, 0x00, 0x00, 0x00, 0x00, 0x1f,
// 	0xf8, 0x00, 0x00, 0x00, 0x00, 0x00, 0x00, 0x00, 0x00, 0x00, 0x00, 0x00, 0x00, 0x00, 0x00, 0x1f,
// 	0xf8, 0x00, 0x00, 0x00, 0x00, 0x00, 0x00, 0x00, 0x00, 0x00, 0x00, 0x00, 0x00, 0x00, 0x00, 0x1f,
// 	0xf8, 0x00, 0x00, 0x00, 0x00, 0x00, 0x00, 0x00, 0x00, 0x00, 0x00, 0x00, 0x00, 0x00, 0x00, 0x1f,
// 	0xfc, 0x00, 0x00, 0x00, 0x00, 0x00, 0x00, 0x00, 0x00, 0x00, 0x00, 0x00, 0x00, 0x00, 0x00, 0x3f,
// 	0xff, 0xff, 0xff, 0xff, 0xff, 0xff, 0xff, 0xff, 0xff, 0xff, 0xff, 0xff, 0xff, 0xff, 0xff, 0xff,
// 	0xff, 0xff, 0xff, 0xff, 0xff, 0xff, 0xff, 0xff, 0xff, 0xff, 0xff, 0xff, 0xff, 0xff, 0xff, 0xff,
// 	0xff, 0xff, 0xff, 0xff, 0xff, 0xff, 0xff, 0xff, 0xff, 0xff, 0xff, 0xff, 0xff, 0xff, 0xff, 0xff,
// 	0xff, 0xff, 0xff, 0xff, 0xff, 0xff, 0xff, 0xff, 0xff, 0xff, 0xff, 0xff, 0xff, 0xff, 0xff, 0xff
// };

//wifi config
#define FORMAT_LITTLEFS_IF_FAILED true

const String config_filename = "/config.json";

String wifi_ssid = "";
String wifi_password = "";

// const char* host = "...";
const char* ap_ssid = "ESP32S3MITMED";
const char* ap_password = "MITMED!!1234";

String content;
int n;

AsyncWebServer server(80);


//MPU9250 config
#define MPU9250_ADDR 0x68
MPU9250_WE myMPU9250 = MPU9250_WE(MPU9250_ADDR);


//MAX30105 config
// MAX30105 particleSensor;
// const byte RATE_SIZE = 4;  //Increase this for more averaging. 4 is good.
// byte rates[RATE_SIZE];     //Array of heart rates
// byte rateSpot = 0;
// long lastBeat = 0;  //Time at which the last beat occurred

// float beatsPerMinute;
// int beatAvg;
#define REPORTING_PERIOD_MS 1000
PulseOximeter pox;

uint32_t tsLastReport = 0;
float filteredBPM = 0;
const float alpha = 0.2;

void onBeatDetected() {
  Serial.println("Beat!");
}


//------------------------------Read/Write Json on flash function------------------------------
bool readConfig() {
  String file_content = readFile(config_filename);

  int config_file_size = file_content.length();
  Serial.println("Config file size: " + String(config_file_size));

  if (config_file_size > 1024) {
    Serial.println("Config file too large");
    return false;
  }
  StaticJsonDocument<1024> doc;
  auto error = deserializeJson(doc, file_content);
  if (error) {
    Serial.println("Error interpreting config file");
    return false;
  }

  const String json_wifi_ssid = doc["ssid"];
  const String json_wifi_password = doc["passwd"];

  wifi_ssid = json_wifi_ssid;
  wifi_password = json_wifi_password;
  return true;
}

bool saveConfig() {
  StaticJsonDocument<1024> doc;

  // write variables to JSON file
  doc["ssid"] = wifi_ssid;
  doc["passwd"] = wifi_password;

  // write config file
  String tmp = "";
  serializeJson(doc, tmp);
  writeFile(config_filename, tmp);

  return true;
}

void writeFile(String filename, String message) {
  File file = LittleFS.open(filename, "w");
  if (!file) {
    Serial.println("writeFile -> failed to open file for writing");
    return;
  }
  if (file.print(message)) {
    Serial.println("File written");
  } else {
    Serial.println("Write failed");
  }
  file.close();
}

String readFile(String filename) {
  File file = LittleFS.open(filename);
  if (!file) {
    Serial.println("Failed to open file for reading");
    return "";
  }

  String fileText = "";
  while (file.available()) {
    fileText = file.readString();
  }
  file.close();
  return fileText;
}


//------------------------------WiFi setup function------------------------------
void createWebServer() {
  {
    server.on("/", HTTP_GET, [](AsyncWebServerRequest* request) {
      request->send(200, "text/html", PAGE_MAIN);
    });

    server.on("/setting", HTTP_POST, [](AsyncWebServerRequest* request) {
      if (request->hasParam("ssid") && request->hasParam("pass")) {
        wifi_ssid = request->getParam("ssid")->value();
        wifi_password = request->getParam("pass")->value();

        Serial.print("writing eeprom ssid:");
        Serial.println(wifi_ssid);

        Serial.print("writing eeprom pass:");
        Serial.println(wifi_password);

        saveConfig();
        ESP.restart();
      }
    });
  }
}

void launchWeb() {
  Serial.println("");
  Serial.print("SoftAP IP: ");
  Serial.println(WiFi.softAPIP());
  createWebServer();
  server.begin();
  Serial.println("Server started");
}

void setupAP() {
  WiFi.mode(WIFI_AP_STA);
  WiFi.softAP(ap_ssid, ap_password);
  launchWeb();
}


void setup() {
  Serial.begin(115200);
  Serial.println("----------------------------- Start ESP32-S3 -----------------------------");

  Wire.begin(8, 9);
  u8g2.setColorIndex(1); 
  u8g2.begin();
  u8g2.setBitmapMode(1);

  if (!LittleFS.begin(false)) {
    Serial.println("LITTLEFS Mount failed");
    Serial.println("Did not find filesystem; starting format");
    if (!LittleFS.begin(true)) {
      Serial.println("LITTLEFS mount failed");
      Serial.println("Formatting not possible");
      return;
    } else {
      Serial.println("Formatting");
    }
  } else {
    Serial.println("setup -> SPIFFS mounted successfully");
    if (readConfig() == false) {
      Serial.println("setup -> Could not read Config file -> initializing new file");
      if (saveConfig()) {
        Serial.println("setup -> Config file saved");
      }
    }
    Serial.println("ssid = " + String(wifi_ssid) + ", password = " + String(wifi_password));
  }
  Serial.println("Turning the HotSpot On");
  setupAP();

  Serial.println("Waiting...");

  Serial.print("Connecting to ");
  Serial.println(wifi_ssid);
  WiFi.begin(wifi_ssid, wifi_password);

  while ((WiFi.status() != WL_CONNECTED)) {
    u8g2.clearBuffer();
    u8g2.setFont(u8g_font_7x14);
    u8g2.drawStr(8, 58, "Connecting...");
    u8g2.sendBuffer();
  }

  server.end();
  WiFi.softAPdisconnect(true);

  Serial.println("WiFi connected");
  Serial.println("IP address: ");
  Serial.println(WiFi.localIP());

  u8g2.clearBuffer();
  u8g2.setFont(u8g_font_7x14);
  u8g2.drawStr(8, 58, "Connected");
  u8g2.sendBuffer();


  // if (!myMPU9250.init()) {
  //   Serial.println("MPU9250 does not respond");
  // } else {
  //   Serial.println("MPU9250 is connected");
  // }
  // if (!myMPU9250.initMagnetometer()) {
  //   Serial.println("Magnetometer does not respond");
  // } else {
  //   Serial.println("Magnetometer is connected");
  // }

  // Serial.println("Position you MPU9250 flat and don't move it - calibrating...");
  // delay(1000);
  // myMPU9250.autoOffsets();
  // Serial.println("Done!");

  // myMPU9250.enableGyrDLPF();
  // myMPU9250.setGyrDLPF(MPU9250_DLPF_6);
  // myMPU9250.setSampleRateDivider(5);
  // myMPU9250.setGyrRange(MPU9250_GYRO_RANGE_250);
  // myMPU9250.setAccRange(MPU9250_ACC_RANGE_2G);
  // myMPU9250.enableAccDLPF(true);
  // myMPU9250.setAccDLPF(MPU9250_DLPF_6);
  // myMPU9250.setMagOpMode(AK8963_CONT_MODE_100HZ);
  // delay(200);

  // if (!particleSensor.begin(Wire, I2C_SPEED_FAST))  //Use default I2C port, 400kHz speed
  // {
  //   Serial.println("MAX30105 was not found. Please check wiring/power. ");
  //   while (1)
  //     ;
  // }
  // Serial.println("Place your index finger on the sensor with steady pressure.");

  // particleSensor.setup();
  // particleSensor.setPulseAmplitudeRed(0x0A);
  // particleSensor.setPulseAmplitudeGreen(0);


  initTimeSystem();

  myBtn1.begin();
  myBtn2.begin();
  if (!pox.begin(PULSEOXIMETER_DEBUGGINGMODE_PULSEDETECT )) {
    Serial.println("FAILED");
    for (;;)
      ;
  } else {
    Serial.println("SUCCESS");
  }
  pox.setIRLedCurrent(MAX30100_LED_CURR_27_1MA);
  pox.setOnBeatDetectedCallback(onBeatDetected);
}

void loop() {

  pox.update();
  myBtn1.read();
  myBtn2.read();
  handleButtons();

  if (WiFi.status() == WL_DISCONNECTED) {
    Serial.println("Reconnecting to WiFi...");
    WiFi.disconnect();
    WiFi.reconnect();
  }

  
  // xyzFloat gValue = myMPU9250.getGValues();
  // xyzFloat gyr = myMPU9250.getGyrValues();
  // float resultantG = myMPU9250.getResultantG(gValue);

  // long irValue = particleSensor.getIR();

  // if (checkForBeat(irValue) == true) {
  //   //We sensed a beat!
  //   long delta = millis() - lastBeat;
  //   lastBeat = millis();

  //   beatsPerMinute = 60 / (delta / 1000.0);

  //   if (beatsPerMinute < 255 && beatsPerMinute > 20) {
  //     rates[rateSpot++] = (byte)beatsPerMinute;  //Store this reading in the array
  //     rateSpot %= RATE_SIZE;                     //Wrap variable

  //     //Take average of readings
  //     beatAvg = 0;
  //     for (byte x = 0; x < RATE_SIZE; x++)
  //       beatAvg += rates[x];
  //     beatAvg /= RATE_SIZE;
  //   }
  // }

  // Serial.print("IR=");
  // Serial.print(irValue);
  // Serial.print(", BPM=");
  // Serial.print(beatsPerMinute);
  // Serial.print(", Avg BPM=");
  // Serial.print(beatAvg);
  // Serial.println();


  if (millis() - tsLastReport > REPORTING_PERIOD_MS) {
    float rawBPM = pox.getHeartRate();

    // กรองค่าผิดปกติ (คนเราหัวใจไม่น่าจะเต้นต่ำกว่า 40 หรือเกิน 200 ตอนนั่งเฉยๆ)
    if (rawBPM > 40 && rawBPM < 200) {
      // สูตร Low Pass Filter (Moving Average แบบง่าย)
      if (filteredBPM == 0) filteredBPM = rawBPM;  // ค่าแรก
      else filteredBPM = (filteredBPM * (1.0 - alpha)) + (rawBPM * alpha);

      Serial.print("BPM (Raw): ");
      Serial.print(rawBPM);
      Serial.print(" | BPM (Smooth): ");
      Serial.println(filteredBPM);  // เอาค่านี้ไปโชว์บนจอ
    } else {
      Serial.println("Reading...");  // กำลังหาค่า หรือค่าเพี้ยน
    }

    tsLastReport = millis();
  }
  if (millis() - tsLastScreenUpdate > SCREEN_UPDATE_PERIOD_MS) {
    u8g2.clearBuffer();
    current_screen = actionTriggered;
    if (current_screen == 0) {
      u8g2.drawBitmap(0, 0, 128 / 8, 64, epd_bitmap_background);
      u8g2.setFont(u8g2_font_VCR_OSD_mn);
      u8g2.drawStr(8, 24, getManualDateTime(0).c_str());

      u8g2.setFont(u8g2_font_BitTypeWriter_tr);
      u8g2.drawStr(10, 40, getManualDateTime(1).c_str());

      // u8g2.setFont(u8g2_font_BitTypeWriter_tr);
      // u8g2.drawStr(10, 56, String(actionTriggered).c_str());

      u8g2.drawBitmap(97, 10, 16 / 8, 16, epd_bitmap_icon_heart);

      u8g2.setFont(u8g2_font_DigitalDisco_tn);
      drawStrAtCenter(105, 45, String(int(filteredBPM)).c_str());


    } else if (current_screen == 1) {
      u8g2.drawBitmap(0, 0, 128 / 8, 64, epd_bitmap_alert_background);
      u8g2.setFont(u8g2_font_ImpactBits_tr);
      drawStrAtCenter(64, 16, "ALERT!");

      u8g2.setFont(u8g2_font_IPAandRUSLCD_tr);
      drawStrAtCenter(64, 16 + 7 + 2, "Detect hypoglycemia");

      u8g2.setFont(u8g2_font_IPAandRUSLCD_tr);
      drawStrAtCenter(64, 16 + 7 + 2 + 7 + 2, "Hold left and right");

      u8g2.setFont(u8g2_font_IPAandRUSLCD_tr);
      drawStrAtCenter(64, 16 + 7 + 2 + 7 + 2 + 7 + 2, "button 5 second");

      u8g2.setFont(u8g2_font_IPAandRUSLCD_tr);
      drawStrAtCenter(64, 16 + 7 + 2 + 7 + 2 + 7 + 2 + 7 + 2, "to activate");
    }
    u8g2.sendBuffer();
    tsLastScreenUpdate = millis();
  }
}


//------------------------------Button function------------------------------
void handleButtons() {
  if (myBtn1.pressedFor(5000) && myBtn2.pressedFor(5000)) {
    if (!actionTriggered) {
      Serial.println(">>> SUCCESS: Both buttons held for 5s! <<<");
      actionTriggered = true;
    }
  } else if (myBtn1.isReleased() || myBtn2.isReleased()) {
    actionTriggered = false;
  }
}

//------------------------------Screen function------------------------------
void drawStrAtCenter(int target_center_x, int y, const char* str) {
  int textWidth = u8g2.getStrWidth(str);
  int x = target_center_x - (textWidth / 2);
  u8g2.drawStr(x, y, str);
}

//------------------------------Time function------------------------------
// String getLocalTime(int sel) {
//   struct tm timeinfo;
//   if (!getLocalTime(&timeinfo)) {
//     Serial.println("Failed to obtain time");
//     return "";  // Return empty string on failure
//   }

//   char buffer[20];  // Temporary buffer

//   if (sel) {
//     strftime(buffer, 20, "%R", &timeinfo);
//   } else {
//     strftime(buffer, 20, "%a,%e %b", &timeinfo);
//   }

//   return String(buffer);  // Returns a copy as a String object
// }


void initTimeSystem() {
    if (WiFi.status() == WL_CONNECTED) {
        configTime(gmtOffset_sec, daylightOffset_sec, ntpServer);

        struct tm timeinfo;
        // พยายามดึงเวลา (ลอง 5 ครั้ง)
        for (int i=0; i<5; i++) {
           if (getLocalTime(&timeinfo)) {
               time(&initialEpoch);
               initialMillis = millis();
               isTimeSynced = true;
               
               Serial.println("\nTime Synced Successfully!");
               Serial.print("Current Epoch: ");
               Serial.println(initialEpoch);
               
               break; 
           }
           Serial.println("Retrying NTP...");
           delay(1000);
        }
        // WiFi.disconnect(true);
        // WiFi.mode(WIFI_OFF);
        // Serial.println("WiFi Disconnected to save sensor resource.");
    } else {
        Serial.println("\nWiFi Failed - Time will start from 00:00:00");
    }
}

// Parameter: showDate -> true=ขอวันที่, false=ขอเวลา
String getManualDateTime(bool showDate) {
    if (!isTimeSynced) return "Waiting...";

    time_t currentEpoch = initialEpoch + ((millis() - initialMillis) / 1000);
    struct tm * timeinfo = localtime(&currentEpoch);
    char buffer[30];
    
    if (showDate) {
        // Format วันที่: "Wed, 17 Dec"
        strftime(buffer, 30, "%a,%e %b", timeinfo);
    } else {
        // Format เวลา: "HH:MM"
        strftime(buffer, 30, "%R", timeinfo); 
    }

    return String(buffer);
}